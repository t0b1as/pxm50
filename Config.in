## Config.in
```kconfig
source "$BR2_EXTERNAL_PXM50_PATH/package/pxm50-lvgl/Config.in"
source "$BR2_EXTERNAL_PXM50_PATH/package/pxm50-panel/Config.in"
```

## configs/pxm50_defconfig
```kconfig
# --- Arch ---
BR2_arm=y
BR2_cortex_a8=y
BR2_ARM_FPU_NEON=y
BR2_TOOLCHAIN_EXTERNAL=y
BR2_TOOLCHAIN_EXTERNAL_BOOTLIN=y
# --- System ---
BR2_TARGET_GENERIC_HOSTNAME="pxm50"
BR2_TARGET_GENERIC_ISSUE="PXM50 HA-Panel v0.6"
BR2_ROOTFS_DEVICE_CREATION_DYNAMIC_EUDEV=y
BR2_TARGET_GENERIC_ROOT_PASSWD="pxm50"
BR2_TARGET_GENERIC_GETTY_PORT="tty1"
BR2_SYSTEM_DHCP="eth0"
BR2_ROOTFS_OVERLAY="$(BR2_EXTERNAL_PXM50_PATH)/board/pxm50/rootfs-overlay"
BR2_ROOTFS_POST_IMAGE_SCRIPT="$(BR2_EXTERNAL_PXM50_PATH)/board/pxm50/post-image.sh"
# --- Kernel ---
BR2_LINUX_KERNEL=y
BR2_LINUX_KERNEL_CUSTOM_VERSION=y
BR2_LINUX_KERNEL_CUSTOM_VERSION_VALUE="6.6.58"
BR2_LINUX_KERNEL_DEFCONFIG="omap2plus"
BR2_LINUX_KERNEL_CONFIG_FRAGMENT_FILES="$(BR2_EXTERNAL_PXM50_PATH)/board/pxm50/linux.fragment"
BR2_LINUX_KERNEL_ZIMAGE=y
BR2_LINUX_KERNEL_NEEDS_HOST_OPENSSL=y
# --- Pakete (Diagnose) ---
BR2_PACKAGE_DROPBEAR=y
BR2_PACKAGE_EVTEST=y
BR2_PACKAGE_TSLIB=y
BR2_PACKAGE_I2C_TOOLS=y
BR2_PACKAGE_USBUTILS=y
BR2_PACKAGE_MTD=y
BR2_PACKAGE_ETHTOOL=y
# --- Rootfs ---
BR2_TARGET_ROOTFS_EXT2=y
BR2_TARGET_ROOTFS_EXT2_4=y
BR2_TARGET_ROOTFS_EXT2_SIZE="128M"
# BR2_TARGET_ROOTFS_TAR is not set
# --- U-Boot (am335x_evm: ohne TI-EEPROM -> Default-Zweig = DDR2 BeagleBone White @266 MHz) ---
BR2_TARGET_UBOOT=y
BR2_TARGET_UBOOT_BUILD_SYSTEM_KCONFIG=y
BR2_TARGET_UBOOT_CUSTOM_VERSION=y
BR2_TARGET_UBOOT_CUSTOM_VERSION_VALUE="2024.01"
BR2_TARGET_UBOOT_BOARD_DEFCONFIG="am335x_evm"
BR2_TARGET_UBOOT_CONFIG_FRAGMENT_FILES="$(BR2_EXTERNAL_PXM50_PATH)/board/pxm50/uboot.fragment"
BR2_TARGET_UBOOT_NEEDS_DTC=y
BR2_TARGET_UBOOT_NEEDS_OPENSSL=y
BR2_TARGET_UBOOT_NEEDS_GNUTLS=y
BR2_TARGET_UBOOT_FORMAT_IMG=y
BR2_TARGET_UBOOT_SPL=y
BR2_TARGET_UBOOT_SPL_NAME="MLO"
# --- Host-Tools ---
BR2_PACKAGE_HOST_DTC=y
BR2_PACKAGE_HOST_DOSFSTOOLS=y
BR2_PACKAGE_HOST_GENIMAGE=y
BR2_PACKAGE_HOST_MTOOLS=y
# --- HA-Panel ---
BR2_PACKAGE_PXM50_PANEL=y
BR2_PACKAGE_LIBCURL=y
BR2_PACKAGE_CJSON=y
BR2_PACKAGE_JPEG=y
BR2_PACKAGE_JPEG_TURBO=y
BR2_PACKAGE_DEJAVU=y
```

## package/pxm50-lvgl/Config.in
```kconfig
config BR2_PACKAGE_PXM50_LVGL
	bool
	help
	  LVGL-Quellen (nur Download/Entpacken) für pxm50-panel.
```

## package/pxm50-panel/Config.in
```kconfig
config BR2_PACKAGE_PXM50_PANEL
	bool "pxm50-panel"
	depends on BR2_TOOLCHAIN_HAS_THREADS
	select BR2_PACKAGE_PXM50_LVGL
	select BR2_PACKAGE_LIBCURL
	select BR2_PACKAGE_CJSON
	select BR2_PACKAGE_JPEG
	select BR2_PACKAGE_TSLIB
	select BR2_PACKAGE_DEJAVU
	help
	  Home-Assistant-Wandpanel für Siemens PXM50 (LVGL auf fbdev).
```
